## firmware-v2/components/board_cyd/Kconfig
```kconfig
menu "Board"

    config WB_BOARD_CYD
        bool "ESP32-2432S028R (CYD) 屏幕与触摸"
        depends on IDF_TARGET_ESP32
        default y if IDF_TARGET_ESP32
        help
            ILI9341(SPI3) + XPT2046(SPI2) + 背光 GPIO21。关掉就只剩串口，
            UI 会回落到无屏模式。换板子写一个同接口的组件即可，不用动 UI。

endmenu
```

## firmware-v2/components/hal_ble/Kconfig
```kconfig
menu "Wireless"

    config WB_BLE
        bool "BLE 底层接口（NimBLE 广播 / 扫描）"
        depends on BT_ENABLED
        depends on IDF_TARGET_ESP32 || IDF_TARGET_ESP32C3 || IDF_TARGET_ESP32C5 || IDF_TARGET_ESP32C6 || IDF_TARGET_ESP32C2 || IDF_TARGET_ESP32H2 || IDF_TARGET_ESP32S3
        default y
        help
            开一套 BLE 广播和扫描的底层接口，给 wbus 那头当成一个新射频用。
            前提是系统里已经开了 Bluetooth（CONFIG_BT_ENABLED）并选了 NimBLE host，
            否则这个选项根本不会出现。
            经典 ESP32 只能发 legacy 广播，31 字节封顶；C5 / C6 / S3 还能走扩展广播。
            不想要 BLE 就关掉，串口和屏幕那边照常工作。

endmenu
```

## firmware-v2/components/wireless_ui/Kconfig
```kconfig
menu "Wireless UI"

    config WB_LVGL
        bool "Enable the LVGL touch UI"
        help
            屏幕和触屏只是把同样的命令行交给 wbus，攻击逻辑只有一份。
            打开后需要有板级组件提供 plat_lcd_* / plat_touch_*（见 board_cyd）；
            没有板级实现时自动回落成无屏。

endmenu
```

## lab/ble_pair_probe/sdkconfig.defaults
```kconfig
CONFIG_BT_ENABLED=y
CONFIG_BT_NIMBLE_ENABLED=y
CONFIG_BT_NIMBLE_ROLE_CENTRAL=y
CONFIG_BT_NIMBLE_ROLE_OBSERVER=y
CONFIG_BT_NIMBLE_SECURITY_ENABLE=y
CONFIG_BT_NIMBLE_MAX_BONDS=3
CONFIG_BT_NIMBLE_SM_SC=y
CONFIG_ESP_CONSOLE_UART_DEFAULT=y
```
