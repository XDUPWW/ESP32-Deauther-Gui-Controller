## firmware/components/wireless_ui/Kconfig
```kconfig
menu "Wireless Attack UI (LVGL)"

    config WIRELESS_ATTACK_LVGL_SUPPORT
        bool "Enable LVGL touch UI (local screen + touch)"
        depends on IDF_TARGET_ESP32
        default n
        help
            Adds a local touch UI on top of the serial console: a three level menu
            (Deauth One/All/Only/Except, Probe flood, Evil Twin) plus a modal
            target-picker popup. Every button only emits the same command lines the
            serial console accepts, so the firmware keeps working unchanged when
            this option is off.

            Only meaningful on targets with the ILI9341 + XPT2046 wiring of the
            ESP32-2432S028R (CYD) board.

    config WIRELESS_UI_CJK_CUSTOM
        bool "Use the project's own CJK subset for the UI font"
        default y
        help
            Uses components/wireless_ui/fonts/lv_font_ui_cjk.c, generated by
            tools/gen_cjk_font.py (a few hundred common hanzi + ASCII, ~60 KB).
            Turn this off to fall back to LVGL's built-in CJK subset (~191 KB)
            or to Latin-only rendering.

endmenu
```
